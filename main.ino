#include <Wire.h>
#include <Adafruit_GFX.h>
#include <Adafruit_SSD1306.h>
#include <FluxGarage_RoboEyes.h>
#include "qrcode.h"   

#define SCREEN_WIDTH  128
#define SCREEN_HEIGHT  64
#define OLED_RESET     -1
#define OLED_ADDR    0x3C
#define SDA_PIN        D1
#define SCL_PIN        D2

Adafruit_SSD1306 display(SCREEN_WIDTH, SCREEN_HEIGHT, &Wire, OLED_RESET);
RoboEyes<Adafruit_SSD1306> roboEyes(display);

#define BTN_LEFT   D5
#define BTN_SELECT D6
#define BTN_RIGHT  D7

bool anyButton() {
  return digitalRead(BTN_LEFT)   == LOW ||
         digitalRead(BTN_RIGHT)  == LOW ||
         digitalRead(BTN_SELECT) == LOW;
}
void waitForButtonRelease() { while (anyButton()) delay(10); }

// ================= Boot logo (128×64) =================
const unsigned char logo_128x64 [] PROGMEM = {
  0x00,0x00,0x00,0x00,0x00,0x00,0x00,0x00,0x00,0x00,0x00,0x00,0x00,0x00,0x00,0x00,
  0x00,0x00,0x00,0x00,0x00,0x00,0x00,0x00,0x00,0x00,0x00,0x00,0x00,0x00,0x00,0x00,
  0x00,0x00,0x00,0x00,0x00,0x00,0x00,0x00,0x00,0x00,0x00,0x00,0x00,0x00,0x00,0x00,
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  0x00,0x00,0x00,0x00,0x00,0x00,0x00,0x00,0x00,0x00,0x00,0x00,0x00,0x00,0x00,0x00
};

#define SETUP_URL "https://n3tm4t3.me"

void drawQRCode(const char* url, int offsetX, int offsetY, int pixelSize) {
  QRCode qrcode;


  uint8_t qrcodeData[qrcode_getBufferSize(3)];
  qrcode_initText(&qrcode, qrcodeData, 3, ECC_LOW, url);

  for (uint8_t y = 0; y < qrcode.size; y++) {
    for (uint8_t x = 0; x < qrcode.size; x++) {
      bool filled = qrcode_getModule(&qrcode, x, y);
      if (pixelSize == 1) {
        if (filled) display.drawPixel(offsetX + x, offsetY + y, WHITE);
      } else {
      
        int px = offsetX + x * pixelSize;
        int py = offsetY + y * pixelSize;
        if (filled) display.fillRect(px, py, pixelSize, pixelSize, WHITE);
      }
    }
  }
}


void bootTextAnimation() {
  display.clearDisplay();
  display.setTextColor(WHITE);
  display.setTextSize(2);
  const char* text = "NET WRAITH";
  int x = 4, y = 24;
  for (int i = 0; text[i] != '\0'; i++) {
    display.setCursor(x, y);
    display.print(text[i]);
    display.display();
    x += 12;
    delay(80);
  }
  delay(700);
}

void bootLogo() {
  display.clearDisplay();
  display.drawBitmap(0, 0, logo_128x64, 128, 64, WHITE);
  display.display();
  delay(1600);
}

void drawSetupScreen() {
  display.clearDisplay();
  display.setTextWrap(false);
  display.setTextColor(WHITE);

  display.setTextSize(1);
  // "SETUP MODE" = 10 chars × 6px = 60px → centred at x=34
  display.setCursor(34, 1);
  display.print("SETUP MODE");
  display.drawFastHLine(0, 10, 128, WHITE);


  display.clearDisplay();
  display.setTextWrap(false);
  display.setTextColor(WHITE);

  drawQRCode(SETUP_URL, 1, 3, 2);   // x=1, y=3, pixelSize=2 → 58×58

  display.drawFastVLine(61, 0, 64, WHITE);


  int tx = 64;

  display.setTextSize(1);

  display.setCursor(tx + 4, 2);
  display.print("SETUP MODE");
  display.drawFastHLine(tx, 11, 66, WHITE);

  display.setCursor(tx + 2, 15);
  display.print("Hi, myself");

  display.setCursor(tx + 2, 26);
  display.print("n3tm4t3 wanna");

  display.setCursor(tx + 2, 37);
  display.print("know more");

  display.setCursor(tx + 2, 48);
  display.print("about me?");

  display.setCursor(tx + 2, 57);
  display.print("scan QR <3");

  display.display();
}

void setup() {
  pinMode(BTN_LEFT,   INPUT_PULLUP);
  pinMode(BTN_SELECT, INPUT_PULLUP);
  pinMode(BTN_RIGHT,  INPUT_PULLUP);

  Wire.begin(SDA_PIN, SCL_PIN);

  display.begin(SSD1306_SWITCHCAPVCC, OLED_ADDR);
  display.clearDisplay();
  display.display();
  display.setRotation(0);
  display.setTextWrap(false);


  bootTextAnimation();   
  bootLogo();            


  drawSetupScreen();
}

void loop() {
  // Screen stays on permanently.
  // Nothing else runs — no deauth detection, no menu, no eyes.
  // The device is a QR display kiosk at this point.
  // Victim scans → rickrolled. Done.
  delay(100);
}
